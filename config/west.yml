## config/west.yml
```yaml
manifest:
  remotes:
    - name: zmkfirmware
      url-base: https://github.com/zmkfirmware
    - name: NathanDSanta
      url-base: https://github.com/NathanDSanta
    - name: zzeneg
      url-base: https://github.com/zzeneg
  projects:
    - name: zmk
      remote: zmkfirmware
      revision: main
      import: app/west.yml
    - name: chocofi
      remote: NathanDSanta
      revision: main
    - name: zmk-raw-hid
      remote: zzeneg
      revision: main
    - name: zmk-deck-key
      remote: NathanDSanta
      revision: main
  self:
    path: config
```
